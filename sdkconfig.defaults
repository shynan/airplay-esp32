## sdkconfig.defaults
```kconfig
# Default values

# PSRAM support
CONFIG_SPIRAM=y
CONFIG_SPIRAM_SPEED_80M=y

# FLASH mode
CONFIG_ESPTOOLPY_FLASHMODE_QIO=y
CONFIG_ESPTOOLPY_FLASHMODE="qio"

# CPU frequency
CONFIG_ESP_DEFAULT_CPU_FREQ_MHZ_240=y
CONFIG_ESP_DEFAULT_CPU_FREQ_MHZ=240

# WiFi
CONFIG_ESP_WIFI_STATIC_RX_BUFFER_NUM=10
CONFIG_ESP_WIFI_DYNAMIC_RX_BUFFER_NUM=32
CONFIG_ESP_WIFI_DYNAMIC_TX_BUFFER_NUM=32

# mDNS
CONFIG_MDNS_MAX_SERVICES=10

# LWIP - increase socket limits for AirPlay
CONFIG_LWIP_MAX_SOCKETS=20

# Logging
CONFIG_LOG_DEFAULT_LEVEL_INFO=y
CONFIG_LOG_DEFAULT_LEVEL=3
CONFIG_LOG_COLORS=y

# DAC Configuration - TAS5825
CONFIG_DAC_TAS58XX=y
CONFIG_TAS58XX_MAX_VOLUME=-10

# Pin Configuration - TAS5825
# I2C for DAC control
CONFIG_DAC_I2C_SDA=2
CONFIG_DAC_I2C_SCL=4

# I2S for audio data
CONFIG_I2S_BCK_IO=15
CONFIG_I2S_WS_IO=14
CONFIG_I2S_DO_IO=13

# Power Down / Mute GPIO
CONFIG_MUTE_GPIO=12
CONFIG_PARTITION_TABLE_CUSTOM=y
CONFIG_PARTITION_TABLE_CUSTOM_FILENAME="components/boards/partitions-2m.csv"
CONFIG_ESPTOOLPY_FLASHSIZE_2MB=y

# Compiler optimization
CONFIG_COMPILER_OPTIMIZATION_PERF=y
```

## sdkconfig.defaults.esparagus-audio-brick
```kconfig
# Esparagus Audio Brick defaults
CONFIG_BOARD_ESPARAGUS_AUDIO_BRICK=y
CONFIG_ESPTOOLPY_FLASHSIZE_8MB=y
CONFIG_ESPTOOLPY_FLASHSIZE="8MB"
CONFIG_DAC_TAS58XX=y
CONFIG_DAC_CONTROLS_VOLUME=y

# GPIO config
CONFIG_I2S_BCK_IO=26
CONFIG_I2S_WS_IO=25
CONFIG_I2S_DO_IO=22
CONFIG_DAC_I2C_SDA=21
CONFIG_DAC_I2C_SCL=27
CONFIG_JACK_GPIO=34
CONFIG_DACWARN_GPIO=36
CONFIG_SPKFAULT_GPIO=39
```

## sdkconfig.defaults.ota
```kconfig
# Default values

# PSRAM support
CONFIG_SPIRAM=y
CONFIG_SPIRAM_SPEED_80M=y
# Increase reserved internal RAM for BT+WiFi coexistence
# BT controller needs internal RAM for critical data structures
CONFIG_SPIRAM_MALLOC_RESERVE_INTERNAL=65536

# FLASH mode
CONFIG_ESPTOOLPY_FLASHMODE_QIO=y
CONFIG_ESPTOOLPY_FLASHMODE="qio"

# CPU frequency
CONFIG_ESP_DEFAULT_CPU_FREQ_MHZ_240=y
CONFIG_ESP_DEFAULT_CPU_FREQ_MHZ=240

# WiFi - reduced buffers for BT+WiFi coexistence
CONFIG_ESP_WIFI_STATIC_RX_BUFFER_NUM=6
CONFIG_ESP_WIFI_DYNAMIC_RX_BUFFER_NUM=24
CONFIG_ESP_WIFI_DYNAMIC_TX_BUFFER_NUM=24

# mDNS
CONFIG_MDNS_MAX_SERVICES=10

# LWIP - increase socket limits for AirPlay
CONFIG_LWIP_MAX_SOCKETS=20

# Logging
CONFIG_LOG_DEFAULT_LEVEL_INFO=y
CONFIG_LOG_DEFAULT_LEVEL=3
CONFIG_LOG_COLORS=y

# DAC Configuration - TAS5825
CONFIG_DAC_TAS58XX=y
CONFIG_TAS58XX_MAX_VOLUME=-10

# Pin Configuration - TAS5825
# I2C for DAC control
CONFIG_DAC_I2C_SDA=2
CONFIG_DAC_I2C_SCL=4

# I2S for audio data
CONFIG_I2S_BCK_IO=15
CONFIG_I2S_WS_IO=14
CONFIG_I2S_DO_IO=13

# Power Down / Mute GPIO
CONFIG_MUTE_GPIO=12

# Partition table (4MB flash with OTA support)
CONFIG_PARTITION_TABLE_CUSTOM=y
CONFIG_PARTITION_TABLE_CUSTOM_FILENAME="components/boards/partitions-4m-ota.csv"
CONFIG_ESPTOOLPY_FLASHSIZE_4MB=y

# Bluetooth A2DP Sink (ESP32 only)
# Coexistence mode: both AirPlay and Bluetooth available
# When one connects, the other is disabled
CONFIG_BT_ENABLED=y
CONFIG_BTDM_CTRL_MODE_BR_EDR_ONLY=y
CONFIG_BT_BLUEDROID_ENABLED=y
CONFIG_BT_CLASSIC_ENABLED=y
CONFIG_BT_A2DP_ENABLE=y
CONFIG_A2DP_SINK_ENABLED=y
# CONFIG_BT_ONLY_MODE is not set
CONFIG_BT_BLE_ENABLED=n
CONFIG_BT_SSP_ENABLED=y
CONFIG_BTDM_CTRL_BR_EDR_MAX_ACL_CONN=1
CONFIG_BT_ACL_CONNECTIONS=1
CONFIG_BT_ALLOCATION_FROM_SPIRAM_FIRST=y

# WiFi/Bluetooth coexistence optimization
CONFIG_ESP_COEX_SW_COEXIST_ENABLE=y
CONFIG_BTDM_CTRL_COEX_TYPE=2

# Bluetooth memory optimization - reduce internal RAM usage
CONFIG_BT_CTRL_SLEEP_MODE_EFF=y
CONFIG_BT_CTRL_LOW_POWER_CLOCK=n
CONFIG_BTDM_CTRL_BLE_SLEEP_GUARD=0
CONFIG_BTDM_CTRL_SLAVE_BLE_OSC_INTERVAL=400

# FreeRTOS timer queue (needed for BT)
CONFIG_FREERTOS_TIMER_QUEUE_LENGTH=16

# Compiler optimization
CONFIG_COMPILER_OPTIMIZATION_PERF=y

# ============================================================
# OTA Configuration
# ============================================================
# Enable OTA rollback protection
CONFIG_BOOTLOADER_APP_ROLLBACK_ENABLE=y
CONFIG_BOOTLOADER_APP_ANTI_ROLLBACK=y

# Skip OTA validation on boot for faster startup
# CONFIG_BOOTLOOTA_SKIP_VALIDATE_IN_DEEP_SLEEP is not set
```
